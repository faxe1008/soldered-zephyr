## boards/xtensa/inkplate_6color/Kconfig.board
```kconfig
# Inkplate 6Color board configuration

# Copyright (c) 2023 Fabian Blatz <fabianblatz@gmail.com>
# SPDX-License-Identifier: Apache-2.0

config BOARD_INKPLATE_6COLOR
	bool "Inkplate 6Color Development Board"
	depends on SOC_SERIES_ESP32

choice SOC_PART_NUMBER
	default SOC_ESP32_D0WD_V3
endchoice
```

## boards/xtensa/inkplate_6color/Kconfig.defconfig
```kconfig
# Copyright (c) 2023 Fabian Blatz <fabianblatz@gmail.com>
# SPDX-License-Identifier: Apache-2.0

if BOARD_INKPLATE_6COLOR

config BOARD
	default "inkplate_6color"

config ENTROPY_GENERATOR
	default y

config HEAP_MEM_POOL_SIZE
	default 98304 if WIFI
	default 65536 if BT
	default 4096

config KERNEL_MEM_POOL
	default y

endif # BOARD_INKPLATE_6COLOR
```

## boards/xtensa/inkplate_6color/inkplate_6color_defconfig
```kconfig
# Copyright (c) 2023 Fabian Blatz <fabianblatz@gmail.com>
# SPDX-License-Identifier: Apache-2.0

CONFIG_BOARD_INKPLATE_6COLOR=y

CONFIG_SOC_SERIES_ESP32=y

CONFIG_MAIN_STACK_SIZE=2048
CONFIG_ESP_HEAP_MEM_POOL_REGION_1_SIZE=0

CONFIG_GPIO=y

CONFIG_CONSOLE=y
CONFIG_SERIAL=y
CONFIG_UART_CONSOLE=y

CONFIG_SHELL=y
```

## west.yml
```yaml
# Copyright (c) 2021 Nordic Semiconductor ASA
# SPDX-License-Identifier: Apache-2.0

manifest:
  self:
    west-commands: scripts/west-commands.yml

  remotes:
    - name: zephyrproject-rtos
      url-base: https://github.com/zephyrproject-rtos

  projects:
    - name: zephyr
      remote: zephyrproject-rtos
      revision: 38470a42316c4e15077b238fda229eab8a6e0b4f
      import: true
```
